## config/west.yml
```yaml
manifest:
  remotes:
    # Default ZMK firmware
    - name: zmkfirmware
      url-base: https://github.com/zmkfirmware
    - name: joelspadin
      url-base: https://github.com/joelspadin
  projects:
    # Default ZMK firmware
    - name: zmk
      remote: zmkfirmware
      revision: v0.3
      import: app/west.yml
    # Locales
    - name: zmk-locales
      remote: joelspadin
      revision: main
  self:
    path: config
```
